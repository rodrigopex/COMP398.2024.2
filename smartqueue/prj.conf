## CMakeLists.txt
```
# SPDX-License-Identifier: Apache-2.0

cmake_minimum_required(VERSION 3.20.0)

find_package(Zephyr REQUIRED HINTS $ENV{ZEPHYR_BASE})
project(es_aula_threads)

list(APPEND SRCS src/main.c src/calc.c src/led.c src/button.c)

# zephyr_library_sources_ifdef(CONFIG_GREETINGS src/greetings.c)

zephyr_include_directories(include)

target_sources(app PRIVATE ${SRCS})
```

## prj.conf
```kconfig
# nothing here
CONFIG_QEMU_ICOUNT=n
CONFIG_NO_OPTIMIZATIONS=n

CONFIG_HAS_SCREEN=y

#CONFIG_GPIO=y
CONFIG_SHELL=y
```

## src/main.c
```c
#include "button.h"
#include "calc.h"
#include "led.h"
#include <zephyr/kernel.h>

void change_led_config(const struct zbus_channel *chan)
{
	struct button_evt *evt = (struct button_evt *)zbus_chan_const_msg(chan);

	struct led_config led_cfg;
	zbus_chan_read(&chan_led_config, &led_cfg, K_NO_WAIT);

	led_cfg.flashing = evt->on;
	zbus_chan_pub(&chan_led_config, &led_cfg, K_NO_WAIT);
}

ZBUS_LISTENER_DEFINE(lis_button_evt_connect_led_config, change_led_config);

ZBUS_CHAN_ADD_OBS(chan_button_evt, lis_button_evt_connect_led_config, 3);

int main(int argc, char *argv[])
{

	int ret = 0, err;

	if (ret) {
		printk("Could no init button!\n");
	}

	err = calc('+', 10, 20, &ret);
	if (err) {
		printk("Operation not permited\n");
	}

	printk("Sum(10,20)=%d\n", ret);

	return 0;
}
```

## include/button.h
```c
#include <zephyr/kernel.h>
#include <zephyr/zbus/zbus.h>

struct button_evt {
	bool on;
};

ZBUS_CHAN_DECLARE(chan_button_evt);
```

## include/calc.h
```c
#ifndef _CALCULATOR_H_
#define _CALCULATOR_H_

/**
 * @brief Calculator function
 *
 * @param op operator '+' for sum, '/' for div
 * @param a first operand
 * @param b second operand
 * @param[out] result Reference to the result
 * @retval 0 if success
 * @retval negative if failed */
int calc(char op, int a, int b, int *result);

#endif /* !_CALCULATOR_H_ */
```

## include/led.h
```c
/**
 * @file
 * @brief Led API
 */

#include <zephyr/kernel.h>
#include <zephyr/zbus/zbus.h>

struct led_config {
	bool flashing;
	int32_t sleep_time_ms;
};

ZBUS_CHAN_DECLARE(chan_led_config);

// /**
//  * @brief Led flashing get function
//  *
//  * @param[out] bool true if is flashing and false otherwise.
//  * @return int 0 on success negative otherwise
//  */
// int led_get_flashing(bool *is_flashing);
//
// /**
//  * @brief Led flashing set function.
//  *
//  * @param should_flash bool indicates the desired state
//  * @retval 0 success
//  * @return int 0 on success negative otherwise
//  */
// int led_set_flashing(bool should_flash);
```

## src/button.c
```c
#include "button.h"

#include <inttypes.h>
#include <zephyr/device.h>
#include <zephyr/drivers/gpio.h>
#include <zephyr/kernel.h>
#include <zephyr/sys/printk.h>
#include <zephyr/sys/util.h>

#define SLEEP_TIME_MS 1

/*
 * Get button configuration from the devicetree sw0 alias. This is mandatory.
 */
#define SW0_NODE DT_ALIAS(sw0)
#if !DT_NODE_HAS_STATUS_OKAY(SW0_NODE)
#error "Unsupported board: sw0 devicetree alias is not defined"
#endif
static const struct gpio_dt_spec button = GPIO_DT_SPEC_GET_OR(SW0_NODE, gpios, {0});
static struct gpio_callback button_cb_data;

ZBUS_CHAN_DEFINE(chan_button_evt, struct button_evt, NULL, NULL, ZBUS_OBSERVERS_EMPTY,
		 ZBUS_MSG_INIT(.on = false))

static struct button_evt evt = {.on = true};

void button_pressed(const struct device *dev, struct gpio_callback *cb, uint32_t pins)
{
	evt.on = !evt.on;
	printk("Button pressed at %" PRIu32 "\n", k_cycle_get_32());
	zbus_chan_pub(&chan_button_evt, &evt, K_NO_WAIT);
}

int button_init(void)
{
	int ret;

	if (!gpio_is_ready_dt(&button)) {
		printk("Error: button device %s is not ready\n", button.port->name);
		return 0;
	}

	ret = gpio_pin_configure_dt(&button, GPIO_INPUT);
	if (ret != 0) {
		printk("Error %d: failed to configure %s pin %d\n", ret, button.port->name,
		       button.pin);
		return 0;
	}

	ret = gpio_pin_interrupt_configure_dt(&button, GPIO_INT_EDGE_TO_ACTIVE);
	if (ret != 0) {
		printk("Error %d: failed to configure interrupt on %s pin %d\n", ret,
		       button.port->name, button.pin);
		return 0;
	}

	gpio_init_callback(&button_cb_data, button_pressed, BIT(button.pin));
	gpio_add_callback(button.port, &button_cb_data);
	printk("Set up button at %s pin %d\n", button.port->name, button.pin);

	return 0;
}

SYS_INIT(button_init, APPLICATION, 99);
```

## src/calc.c
```c
#include "calc.h"

#include <zephyr/kernel.h>
int sum(int a, int b, int *result)
{
	if (result == NULL) {
		return -EINVAL;
	}

	*result = a + b;

	return 0;
}

int div(int a, int b, int *result)
{
	if (result == NULL) {
		return -EINVAL;
	}

	if (b == 0) {
		return -EFAULT;
	}

	if (a >= 1024) {
		return -ENODATA;
	}

	*result = a / b;

	return 0;
}

int calc(char op, int a, int b, int *result)
{
	if (result == NULL) {
		return -EINVAL;
	}

	switch (op) {
	case '+':
		return sum(a, b, result);
	case '/':
		return div(a, b, result);
	default:
		return -EFAULT;
	}
}
```

## src/led.c
```c
#include "led.h"

#include <zephyr/drivers/gpio.h>

/* 1000 msec = 1 sec */
#define SLEEP_TIME_MS 1000

/* The devicetree node identifier for the "led0" alias. */
#define LED0_NODE DT_ALIAS(led0)

ZBUS_CHAN_DEFINE(chan_led_confg, struct led_config, NULL, NULL, ZBUS_OBSERVERS_EMPTY,
		 ZBUS_MSG_INIT(.flashing = true, .sleep_time_ms = 1000));

/*
 * A build error on this line means your board is unsupported.
 * See the sample documentation for information on how to fix this.
 */
static const struct gpio_dt_spec led = GPIO_DT_SPEC_GET(LED0_NODE, gpios);

static struct {
	bool flashing;
	int32_t sleep_time_ms;
} self = {.flashing = true, .sleep_time_ms = SLEEP_TIME_MS};
//
// int led_get_flashing(bool *is_flashing)
// {
// 	int err = k_sem_take(&self.sem, K_NO_WAIT);
// 	if (err) {
// 		return err;
// 	}
//
// 	*is_flashing = self.flashing;
// 	k_sem_give(&self.sem);
//
// 	return 0;
// }
//
// int led_set_flashing(bool is_flashing)
// {
// 	int err = k_sem_take(&self.sem, K_NO_WAIT);
// 	if (err) {
// 		return err;
// 	}
//
// 	self.flashing = is_flashing;
// 	k_sem_give(&self.sem);
//
// 	return 0;
// }
//
static int thread(void *ptr1, void *ptr2, void *ptr3)
{
	ARG_UNUSED(ptr1);
	ARG_UNUSED(ptr2);
	ARG_UNUSED(ptr3);

	int ret;
	bool led_state = true;

	if (!gpio_is_ready_dt(&led)) {
		return 0;
	}

	ret = gpio_pin_configure_dt(&led, GPIO_OUTPUT_ACTIVE);
	if (ret < 0) {
		return 0;
	}

	// k_sem_init(&self.sem, 0, 1);

	int err;
	struct led_config cfg;

	while (1) {
		zbus_chan_read(&chan_led_confg, &cfg, K_FOREVER);

		if (cfg.flashing) {
			ret = gpio_pin_toggle_dt(&led);
			if (ret < 0) {
				return 0;
			}
			printf("LED state: %s\n", led_state ? "ON" : "OFF");

		} else {
			gpio_pin_set_dt(&led, 0);
		}
		led_state = !led_state;

		k_msleep(cfg.sleep_time_ms);
	}
	return 0;
}

K_THREAD_DEFINE(led_thread_id, 1024, thread, NULL, NULL, NULL, 3, 0, 0);
```
