## CMakeLists.txt
```
# SPDX-License-Identifier: Apache-2.0

cmake_minimum_required(VERSION 3.20.0)

find_package(Zephyr REQUIRED HINTS $ENV{ZEPHYR_BASE})
project(es_aula_threads)

list(APPEND SRCS src/main.c)

zephyr_library_sources_ifdef(CONFIG_GREETINGS src/greetings.c)
# if(CONFIG_GREETINGS)
#     message(WARNING "Screen enabled!")
#     list(APPEND SRCS src/greetings.c)
# endif()

zephyr_include_directories(include)
# include_directories(include)

target_sources(app PRIVATE src/main.c)
```

## Kconfig
```
config HAS_SCREEN
    bool "Device has screen"
    default y

menuconfig GREETINGS
    bool "Grettings when we have screen"
    depends on HAS_SCREEN
    default y

if GREETINGS

config FILTER_B
    bool "Avoid making B upper case"
    default y

config FILTER_P
    bool "Avoid making P upper case"
    default y

config UPPER_TRANSFORM_VALUE
    int "Transform value"
    default 32

endif
source "Kconfig.zephyr"
```

## prj.conf
```kconfig
# nothing here
CONFIG_QEMU_ICOUNT=n
CONFIG_NO_OPTIMIZATIONS=n

CONFIG_HAS_SCREEN=y
```

## src/main.c
```c
/**
 * @file
 * @brief [TODO:description]
 */

#include <stdint.h>
#include <zephyr/kernel.h>

#include "greetings.h"

// ponteiros
// estruturas
// union?
// array

enum direction {
	DIRECTION_INPUT,
	DIRECTION_OUTPUT,
	DIRECTION_COUNT,
};
/* */
struct packet_header {
	uint8_t length: 3;
	uint8_t direction: 1;
	uint8_t crc: 4;
};

/** Example of struct that uses bitfield */

struct time {
	uint64_t seconds: 6;
	uint64_t minutes: 6;
	uint64_t hours: 5;
	uint64_t days: 9;
	uint64_t years: 37;
	uint64_t daylightsavings: 1;
};

struct acc {
	int32_t x;
	int16_t y;
	uint8_t z;
	union {
		uint64_t n;
		struct time time;
		uint8_t bytes[8];
	} timestamp;
};

static bool acc_is_valid(const struct acc *acc)
{
	return acc->x > 0;
}

static void acc_print(const struct acc *acc)
{
	printk("Acc timestamp: %02u:%02u:%2u\n", acc->timestamp.time.hours,
	       acc->timestamp.time.minutes, acc->timestamp.time.seconds);
}

size_t sizeof_pointer(const char *data)
{
	return sizeof(data);
}

size_t sizeof_array(const char data[])
{
	return sizeof(data);
}

int main(int argc, char *argv[])
{
	struct packet_header pkt = {.length = 32, .direction = DIRECTION_OUTPUT, .crc = 0xFB};

	struct acc a = {
		.x = 1,
		.y = 10,
		.z = 100,
		.timestamp.time.hours = 1,
		.timestamp.time.minutes = 2,
		.timestamp.time.seconds = 30,
	};
	printk("Is valid: %s\nSizeof acc %d\n", acc_is_valid(&a) ? "true" : "false",
	       sizeof(struct acc));
	acc_print(&a);

#if defined(CONFIG_GREETINGS)
	print_upper("^hello world!$ -> pb");
#endif

	return 0;
}
```

## include/greetings.h
```c
void print_upper(const char *str);
```

## src/greetings.c
```c
#include <zephyr/kernel.h>

void print_upper(const char *str)
{
	for (const char *iter = str; *iter != '\0'; ++iter) {
		char cursor = *iter;
		char dec = 0;
		if ('a' <= cursor && cursor <= 'z') {
			dec = CONFIG_UPPER_TRANSFORM_VALUE;
		}

		if (IS_ENABLED(CONFIG_FILTER_P) && cursor == 'p') {
			dec = 0;
		}

		if (IS_ENABLED(CONFIG_FILTER_B) && cursor == 'b') {
			dec = 0;
		}

		printk("%c", cursor - dec);
	}
}
```
